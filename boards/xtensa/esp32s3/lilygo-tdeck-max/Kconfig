## boards/xtensa/esp32s3/lilygo-tdeck-max/Kconfig
```kconfig
#
# For a description of the syntax of this configuration file,
# see the file kconfig-language.txt in the NuttX tools repository.
#

if ARCH_BOARD_LILYGO_TDECK_MAX

config LILYGO_TDECK_MAX_BOOT_WIFI
	bool "Bring up Wi-Fi at boot"
	default n
	depends on ESPRESSIF_WIFI
	---help---
		Wi-Fi is left uninitialised by default.  Initialising it takes a
		large part of the internal heap, and the network stack starts the
		radio when it brings wlan0 up, so an idle handheld would otherwise
		keep it running for nothing.

		It can be brought up at runtime instead:

		    gpio -o 1 /dev/wifi_en
		    ifup wlan0

		There is no way to take it down again short of a reset, although
		ifdown and ifup stop and start the radio once it is up.

		Bringing it up at boot needs BOARD_INITTHREAD_STACKSIZE of at
		least 4096.  Anything smaller is refused at build time, because
		the failure is a silent reset loop.

config LILYGO_TDECK_MAX_BOOT_BLE
	bool "Bring up Bluetooth LE at boot"
	default n
	depends on ESPRESSIF_BLE
	---help---
		BLE is left uninitialised by default: bringing it up enables the
		controller, which stays enabled.

		It can be brought up at runtime instead:

		    gpio -o 1 /dev/ble_en
		    ifup bnep0

		Bringing it up at boot needs BOARD_INITTHREAD_STACKSIZE of at
		least 4096, as for Wi-Fi.

		There is no way to take it down again short of a reset.

endif # ARCH_BOARD_LILYGO_TDECK_MAX
```

## drivers/wireless/lpwan/sx126x/Kconfig
```kconfig
#
# For a description of the syntax of this configuration file,
# see the file kconfig-language.txt in the NuttX tools repository.
#

if LPWAN_SX126X

config LPWAN_SX126X_RFFREQ_DEFAULT
	int "SX126X default RF frequency Hz"
	default 869252000

config LPWAN_SX126X_SF_DEFAULT
	int "SX126X default spreading factor"
	default 10

config LPWAN_SX126X_BW_DEFAULT
	int "SX126X default bandwidth kHz"
	default 125

config LPWAN_SX126X_CR_DEFAULT
	int "SX126X default coding rate"
	default 8

config LPWAN_SX126X_MAX_DEVICES
	int "SX126X maximum devices"
	default 1
	range 1 4

config LPWAN_SX126X_RXQUEUE
	int "SX126X packets kept while listening"
	default 4
	range 1 16
	---help---
		While the chip listens in the background (SX126XIOC_LISTENSET),
		the packets heard and not read yet, each about 270 bytes; the
		oldest is dropped for a new one.

config LPWAN_SX126X_NPOLLWAITERS
	int "SX126X poll waiters"
	default 2
	range 1 8

endif # LPWAN_SX126X
```
